## conf/distro/ami.conf
```bitbake
#
# An example of a ami distro
#
DISTRO = "ami"

require conf/distro/poky.conf

INHERIT += "extrausers"
# Hardening: Locking the root password. Creating the ewaol without password for ssh key-based login only
EXTRA_USERS_PARAMS = "usermod -L root; useradd -p '*' ewaol"
EXTRA_IMAGE_FEATURES:append = "ssh-server-openssh"
# Forcing removal of debug-tweakes as ewaol includes it in all targets by default and that leads to reversing some sshd_config hardening done in our bbappend when do_rootfs runs
EXTRA_IMAGE_FEATURES:remove = "debug-tweaks"
IMAGE_INSTALL:append = " git rng-tools aws-cli cloud-init cloud-init-systemd e2fsprogs e2fsprogs-resize2fs e2fsprogs-tune2fs e2fsprogs-e2fsck e2fsprogs-mke2fs parted sudo sudo-sudo openssh-sftp-server python3-netifaces python3-charset-normalizer canutils"
IMAGE_FSTYPES += " wic wic.vhdx"
DISTRO_FEATURES:append = " ewaol-baremetal"
DISTRO_FEATURES:append = " systemd"
```

## conf/distro/aws-ec2-ami.conf
```bitbake
require conf/distro/poky.conf

DISTRO = "aws-ec2-ami"
DISTRO_NAME = "ec2 ami distro"

INHERIT += "extrausers"
# Hardening: Locking the root password. Creating the user without password for ssh key-based login only
EXTRA_USERS_PARAMS = "usermod -L root; useradd -p '*' user"
EXTRA_IMAGE_FEATURES:append = "ssh-server-openssh"
# Forcing removal of debug-tweakes as that leads to reversing some sshd_config hardening done in our bbappend when do_rootfs runs
EXTRA_IMAGE_FEATURES:remove = "debug-tweaks"
IMAGE_INSTALL:append = " rng-tools aws-cli cloud-init cloud-init-systemd e2fsprogs e2fsprogs-resize2fs e2fsprogs-tune2fs e2fsprogs-e2fsck e2fsprogs-mke2fs parted sudo sudo-sudo openssh-sftp-server"
IMAGE_FSTYPES += " wic.vhdx"
DISTRO_FEATURES:append = " systemd"
DISTRO_FEATURES:append = " virtualization"

DISTRO_FEATURES_BACKFILL_CONSIDERED:append = " sysvinit"
VIRTUAL-RUNTIME_init_manager = "systemd"
VIRTUAL-RUNTIME_initscripts = "systemd-compat-units"
VIRTUAL-RUNTIME_login_manager = "shadow-base"
VIRTUAL-RUNTIME_dev_manager = "systemd"

# this a bugfix for kirkstone release
PACKAGE_CLASSES = "package_rpm"
```
